## config/boards/shields/harold/Kconfig.defconfig
```kconfig
# Copyright (c) 2022 The ZMK Contributors
# SPDX-License-Identifier: MIT

if SHIELD_HAROLD_LEFT

config ZMK_KEYBOARD_NAME
	default "Harold"

config ZMK_SPLIT_ROLE_CENTRAL
	default y

endif # SHIELD_HAROLD_LEFT

if SHIELD_HAROLD_LEFT || SHIELD_HAROLD_RIGHT

config ZMK_SPLIT
	default y


endif # SHIELD_HAROLD_LEFT || SHIELD_HAROLD_RIGHT
```

## config/boards/shields/harold/Kconfig.shield
```kconfig
# Copyright (c) 2022 The ZMK Contributors
# SPDX-License-Identifier: MIT

config SHIELD_HAROLD_LEFT
	def_bool $(shields_list_contains,harold_left)

config SHIELD_HAROLD_RIGHT
	def_bool $(shields_list_contains,harold_right)
```
