/*
 * Copyright (c) 2022 The ZMK Contributors
 *
 * SPDX-License-Identifier: MIT
 */

#include "harold.dtsi"

/ {
	chosen {
		zmk,kscan = &kscan;
	};

	kscan: kscan {

		col-gpios 
			= <&xiao_d 0  GPIO_ACTIVE_HIGH>
			, <&xiao_d 1  GPIO_ACTIVE_HIGH>
			, <&xiao_d 2  GPIO_ACTIVE_HIGH>
			, <&xiao_d 10 GPIO_ACTIVE_HIGH>
			, <&xiao_d 9  GPIO_ACTIVE_HIGH>
			;

		row-gpios
			= <&xiao_d 8 (GPIO_PULL_DOWN | GPIO_ACTIVE_HIGH)>
			, <&xiao_d 7 (GPIO_PULL_DOWN | GPIO_ACTIVE_HIGH)>
			, <&xiao_d 5 (GPIO_PULL_DOWN | GPIO_ACTIVE_HIGH)>
			, <&xiao_d 6 (GPIO_PULL_DOWN | GPIO_ACTIVE_HIGH)>
			;
	};
};

&default_transform {
	col-offset = <5>;
};
